## CMakeLists.txt
```
cmake_minimum_required(VERSION 3.20.0)
find_package(Zephyr REQUIRED HINTS $ENV{ZEPHYR_BASE})
project(peripheral_periodic)
file(GLOB SOURCES "src/*.c")
target_sources(app PRIVATE ${SOURCES})
```

## prj.conf
```kconfig
# https://docs.zephyrproject.org/latest/kconfig.html
# Enables Zephyr's event subsystem for event-driven programming
CONFIG_EVENTS=y

# Enables GPIO (General Purpose Input/Output) driver support for controlling and reading digital pins
CONFIG_GPIO=y

# Sets the default Bluetooth device name, advertised and used in connections unless overridden at runtime
CONFIG_BT_DEVICE_NAME="Periodic1"
# Enables Bluetooth 5.0 Extended Advertising for larger packets and advanced features
CONFIG_BT_EXT_ADV=y
# Allows the Bluetooth GATT database to be created/modified at runtime, not just at compile time
CONFIG_BT_GATT_DYNAMIC_DB=y
# Enables the Bluetooth Peripheral role, allowing the device to advertise and accept connections from Central devices
CONFIG_BT_PERIPHERAL=y
# Enables the full Bluetooth stack, including LE and (if available) Classic features
CONFIG_BT=y
# Enables Periodic Advertising API support. This allows the device to send advertising data periodically at intervals. https://docs.zephyrproject.org/latest/kconfig.html#CONFIG_BT_PER_ADV
CONFIG_BT_PER_ADV=y

# Enables the system console for input/output of system messages, shell, and debugging
CONFIG_CONSOLE=y
# Redirects printk() output to the Zephyr logging subsystem for unified log management
CONFIG_LOG_PRINTK=y
# Enables Zephyr’s structured, multi-level logging subsystem
CONFIG_LOG=y
# Enables the printk() function for simple, low-level debug output
CONFIG_PRINTK=y
# Routes system console output through SEGGER RTT for high-speed debug communication
CONFIG_RTT_CONSOLE=y
# Enables/disables routing the system console to a UART device (n = disables UART console)
CONFIG_UART_CONSOLE=n
# Enables/disables routing UART output over RTT (n = keeps UART and RTT output separate)
CONFIG_UART_RTT=n
# Enables use of SEGGER RTT for debug output and communication
CONFIG_USE_SEGGER_RTT=y

# Enables display of detailed thread information in debug output (names, priorities, stack usage)
CONFIG_DEBUG_THREAD_INFO=y
# Enables general debugging features, such as runtime checks and debug info
CONFIG_DEBUG=y
# Enables the tracing subsystem for recording and analyzing system events
CONFIG_TRACING=y
# Enables the Thread Monitor, which tracks thread states and can help detect deadlocks or long-running threads
CONFIG_THREAD_MONITOR=y
```

## src/main.c
```c
#include "connection.h"
#include "external_readings.h"
#include "storage.h"
#include "zephyr/bluetooth/bluetooth.h"
#include "zephyr/bluetooth/gatt.h"

static struct bt_conn_cb callbacks = {.connected = connected_callback,
                                      .disconnected = disconnected_callback};

#define SERVICE_UUID 0x183B

static uint8_t periodic_advertising_service_data[] = {
    BT_UUID_16_ENCODE(SERVICE_UUID),
    0x40,
    0,
};

static struct bt_data periodic_advertising_data[] = {
    BT_DATA(BT_DATA_SVC_DATA16, periodic_advertising_service_data,
            ARRAY_SIZE(periodic_advertising_service_data)),
};

static struct bt_data advertising_data[] = {
    // BT_DATA_BYTES(BT_DATA_FLAGS, (BT_LE_AD_GENERAL | BT_LE_AD_NO_BREDR)),
    BT_DATA(BT_DATA_NAME_COMPLETE, CONFIG_BT_DEVICE_NAME,
            sizeof(CONFIG_BT_DEVICE_NAME) - 1),
    // BT_DATA(BT_DATA_SVC_DATA16, periodic_advertising_service_data,
    //         ARRAY_SIZE(periodic_advertising_service_data)),
};

static const struct bt_le_adv_param advertising_parameters[] =
    BT_LE_ADV_PARAM(BT_LE_ADV_OPT_EXT_ADV, BT_GAP_ADV_FAST_INT_MIN_2,
                    BT_GAP_ADV_FAST_INT_MAX_2, NULL);

static int start_advertising(struct bt_le_ext_adv *adv) {
  int err = bt_le_ext_adv_start(adv, BT_LE_EXT_ADV_START_DEFAULT);
  if (err) {
    printk("Failed to start main advertising (err %d)\n", err);
    return err;
  }

  err = bt_le_per_adv_start(adv);
  if (err) {
    printk("Failed to start periodic advertising (err %d)\n", err);
    return err;
  }

  if (!err) {
    k_event_set(&bluetooth_event, ADVERTISING);
  }

  return err;
}

int main(void) {
  int err;

  // This must remain valid memory for the duration of the program. Make it more
  // challenging to move into a function.
  struct bt_le_ext_adv *advertisement_set;

  err = bt_enable(NULL);
  if (err) {
    return err;
  }

  err = bt_le_ext_adv_create(advertising_parameters, NULL, &advertisement_set);
  if (err) {
    return err;
  }

  err = bt_le_ext_adv_set_data(advertisement_set, advertising_data,
                               ARRAY_SIZE(advertising_data), NULL, 0);
  if (err) {
    printk("Failed to set advertising data (err %d)\n", err);
    return err;
  }

  err = bt_le_per_adv_set_param(advertisement_set, BT_LE_PER_ADV_DEFAULT);
  if (err) {
    printk("Failed to set periodic advertising parameters (err %d)\n", err);
    return err;
  }

  err = bt_conn_cb_register(&callbacks);
  if (err) {
    return err;
  }

  err = start_advertising(advertisement_set);
  if (err) {
    printk("Failed to start advertising (err %d)\n", err);
    return err;
  }

  printk("Initializing memory for %d readings\n", 25);
  initialize_storage();

  err = initialize_gpio_readings();
  if (err) {
    printk("could not initialize GPIO readings (err %d)\n", err);
    return err;
  }

  err = initialize_gpio_sampling();
  if (err) {
    printk("could not initialize GPIO sampling (err %d)\n", err);
    return err;
  }

  while (true) {
    k_sleep(K_SECONDS(1));

    // Update periodic advertising data with the latest reading
    const uint8_t reading = sum_stored_readings();

    printk("Updating periodic advertising data with reading: %d\n", reading);
    periodic_advertising_service_data[3] = reading;

    err = bt_le_per_adv_set_data(advertisement_set, periodic_advertising_data,
                                 ARRAY_SIZE(periodic_advertising_data));

    if (err) {
      printk("could not set periodic advertising data (err %d)\n", err);
      return err;
    }
  }
}
```

## src/connection.h
```c
//
// Created by Cory Buecker on 8/10/25.
//

#ifndef NOTIIFER_CONNECTION_H
#define NOTIIFER_CONNECTION_H

#include "zephyr/bluetooth/conn.h"
#include "zephyr/sys/util_macro.h"

// TODO: document how the bitmask works with the event system.
enum ConnectionState {
  DISCONNECTED = BIT(0),
  CONNECTED = BIT(1),
  ADVERTISING = BIT(2),
};

extern struct bt_conn *default_connection;
extern struct k_event bluetooth_event;

void connected_callback(struct bt_conn *connection, uint8_t err);
void disconnected_callback(struct bt_conn *connection, uint8_t reason);
#endif  // NOTIIFER_CONNECTION_H
```

## src/external_readings.h
```c
#ifndef NOTIFIER_GPIO_READINGS_H
#define NOTIFIER_GPIO_READINGS_H

#include "storage.h"
#include "zephyr/drivers/gpio.h"

extern const struct gpio_dt_spec button;

typedef struct external_reading {
  uint8_t value;
  struct external_reading *next;
} external_reading_t;

int initialize_gpio_readings();
int initialize_gpio_sampling();

#endif  // NOTIFIER_GPIO_READINGS_H
```

## src/storage.h
```c
//
// Created by Cory Buecker on 8/12/25.
//

#ifndef NOTIFIER_STORAGE_H
#define NOTIFIER_STORAGE_H

#include "external_readings.h"
#include "zephyr/kernel.h"

#define MAXIMUM_STORED_READINGS 25
#define READING_SIZE_IN_BYTES sizeof(external_reading_t)
#define REQUIRED_MEMORY (READING_SIZE_IN_BYTES * MAXIMUM_STORED_READINGS * 3)

void initialize_storage();

void store_reading(uint8_t value);
uint8_t sum_stored_readings();

#endif  // NOTIFIER_STORAGE_H
```
