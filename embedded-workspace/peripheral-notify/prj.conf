## CMakeLists.txt
```
cmake_minimum_required(VERSION 3.20.0)
find_package(Zephyr REQUIRED HINTS $ENV{ZEPHYR_BASE})
project(peripheral_notify)
file(GLOB SOURCES "src/*.c")
target_sources(app PRIVATE ${SOURCES})
```

## prj.conf
```kconfig
# Enables Zephyr's event subsystem for event-driven programming
CONFIG_EVENTS=y

# Enables GPIO (General Purpose Input/Output) driver support for controlling and reading digital pins
CONFIG_GPIO=y

# Sets the default Bluetooth device name, advertised and used in connections unless overridden at runtime
CONFIG_BT_DEVICE_NAME="Notifier 1"
# Enables Bluetooth 5.0 Extended Advertising for larger packets and advanced features
CONFIG_BT_EXT_ADV=y
# Allows the Bluetooth GATT database to be created/modified at runtime, not just at compile time
CONFIG_BT_GATT_DYNAMIC_DB=y
# Enables the Bluetooth Peripheral role, allowing the device to advertise and accept connections from Central devices
CONFIG_BT_PERIPHERAL=y
# Enables the full Bluetooth stack, including LE and (if available) Classic features
CONFIG_BT=y

# # Enables the system console for input/output of system messages, shell, and debugging
# CONFIG_CONSOLE=y
# # Redirects printk() output to the Zephyr logging subsystem for unified log management
# CONFIG_LOG_PRINTK=y
# # Enables Zephyr’s structured, multi-level logging subsystem
# CONFIG_LOG=y
# # Enables the printk() function for simple, low-level debug output
# CONFIG_PRINTK=y
# # Routes system console output through SEGGER RTT for high-speed debug communication
# CONFIG_RTT_CONSOLE=y
# # Enables/disables routing the system console to a UART device (n = disables UART console)
# CONFIG_UART_CONSOLE=n
# # Enables/disables routing UART output over RTT (n = keeps UART and RTT output separate)
# CONFIG_UART_RTT=n
# # Enables use of SEGGER RTT for debug output and communication
# CONFIG_USE_SEGGER_RTT=y

# # Enables display of detailed thread information in debug output (names, priorities, stack usage)
# CONFIG_DEBUG_THREAD_INFO=y
# # Enables general debugging features, such as runtime checks and debug info
# CONFIG_DEBUG=y
# # Enables the tracing subsystem for recording and analyzing system events
# CONFIG_TRACING=y
```

## src/main.c
```c
#include "zephyr/bluetooth/bluetooth.h"
#include "zephyr/bluetooth/gatt.h"

#include "connection.h"
#include "external_readings.h"
#include "storage.h"

static struct bt_conn_cb callbacks = {.connected = connected_callback,
                                      .disconnected = disconnected_callback};

#define SERVICE_UUID 0x183B
#define CHARACTERISTIC_UUID 0x183C

static const struct bt_uuid_16 service_uuid = BT_UUID_INIT_16(SERVICE_UUID);
static struct bt_data advertising_data[] = {
    BT_DATA_BYTES(BT_DATA_FLAGS, (BT_LE_AD_GENERAL | BT_LE_AD_NO_BREDR)),
    BT_DATA_BYTES(BT_DATA_UUID16_ALL, BT_UUID_16_ENCODE(SERVICE_UUID)),
    BT_DATA(BT_DATA_NAME_COMPLETE, CONFIG_BT_DEVICE_NAME,
            sizeof(CONFIG_BT_DEVICE_NAME) - 1),
};

static void notify_ccc_changed(const struct bt_gatt_attr *attr,
                               uint16_t value) {};

// // These variables HAVE to remain valid memory for the duration of the
// program.
static const struct bt_uuid_16 characteristic_uuid =
    BT_UUID_INIT_16(CHARACTERISTIC_UUID);

struct bt_gatt_attr service_gatt_attributes[] = {
    BT_GATT_PRIMARY_SERVICE(&service_uuid),
    BT_GATT_CHARACTERISTIC(&characteristic_uuid.uuid, BT_GATT_CHRC_NOTIFY,
                           BT_GATT_PERM_NONE, NULL, NULL, NULL),
    BT_GATT_CCC(notify_ccc_changed, BT_GATT_PERM_READ | BT_GATT_PERM_WRITE)};

struct bt_gatt_service service = BT_GATT_SERVICE(service_gatt_attributes);

static int start_advertising(struct bt_le_ext_adv *adv) {
  const int err = bt_le_ext_adv_start(adv, BT_LE_EXT_ADV_START_DEFAULT);

  if (!err) {
    k_event_set(&bluetooth_event, ADVERTISING);
  }

  return err;
}

K_THREAD_STACK_DEFINE(my_stack_area, 4096);
struct k_thread my_thread_data;

void my_thread_entry_point(void *p1, void *p2, void *p3) {
  while (true) {
    k_sleep(K_MSEC(1000));

    const uint8_t reading = sum_stored_readings();

    if (default_connection != NULL) {
      if (bt_gatt_is_subscribed(default_connection, &service_gatt_attributes[1],
                                BT_GATT_CCC_NOTIFY)) {
        const int err =
            bt_gatt_notify(default_connection, &service_gatt_attributes[1],
                           &reading, sizeof(reading));
        if (err) {
          printk("bt_gatt_notify failed (err %d)\n", err);
        }
      }
    }
  }
}

int main(void) {
  int err;

  // This must remain valid memory for the duration of the program. Make it more
  // challenging to move into a function.
  struct bt_le_ext_adv *advertisement_set;

  err = bt_enable(NULL);
  if (err) {
    return err;
  }

  err = bt_gatt_service_register(&service);
  if (err) {
    return err;
  }

  err = bt_le_ext_adv_create(BT_LE_EXT_ADV_CONN, NULL, &advertisement_set);
  if (err) {
    return err;
  }

  err = bt_le_ext_adv_set_data(advertisement_set, advertising_data,
                               ARRAY_SIZE(advertising_data), NULL, 0);
  if (err) {
    return err;
  }

  err = bt_conn_cb_register(&callbacks);
  if (err) {
    return err;
  }

  err = start_advertising(advertisement_set);
  if (err) {
    printk("could not start advertising");
    return err;
  }

  printk("Initializing memory for %d readings\n", 25);
  initialize_storage();

  err = initialize_gpio_readings();
  if (err) {
    printk("could not initialize GPIO readings (err %d)\n", err);
    return err;
  }

  err = initialize_gpio_sampling();
  if (err) {
    printk("could not initialize GPIO sampling (err %d)\n", err);
    return err;
  }

  k_thread_create(&my_thread_data, my_stack_area,
                  K_THREAD_STACK_SIZEOF(my_stack_area), my_thread_entry_point,
                  NULL, NULL, NULL, 8, 0, K_NO_WAIT);

  while (true) {
    printk("Waiting for Bluetooth events...\n");
    k_event_wait(&bluetooth_event, DISCONNECTED, false, K_FOREVER);

    err = start_advertising(advertisement_set);
    if (err) {
      k_event_set(&bluetooth_event, DISCONNECTED);
      k_sleep(K_SECONDS(1));
    }

    printk("Advertising started successfully!\n");
  }
}
```

## src/connection.c
```c
#include "connection.h"

K_EVENT_DEFINE(bluetooth_event);
struct bt_conn *default_connection;

void connected_callback(struct bt_conn *connection, uint8_t err) {
  if (err) {
    return;
  }

  if (default_connection == NULL) {
    default_connection = bt_conn_ref(connection);
  }

  if (default_connection != connection) {
    return;
  }

  printk("client connected to server...");

  k_event_set(&bluetooth_event, CONNECTED);
}

void disconnected_callback(struct bt_conn *connection, uint8_t reason) {
  bt_conn_unref(default_connection);
  default_connection = NULL;

  switch (reason) {
  case BT_HCI_ERR_AUTH_FAIL:
    printk("disconnected: authentication failed (0x%02x)\n", reason);
    break;

  case BT_HCI_ERR_REMOTE_USER_TERM_CONN:
    printk("disconnected: remote user terminated connection (0x%02x)\n",
           reason);
    break;

  case BT_HCI_ERR_REMOTE_LOW_RESOURCES:
    printk("disconnected: remote low resources (0x%02x)\n", reason);
    break;

  case BT_HCI_ERR_REMOTE_POWER_OFF:
    printk("disconnected: remote powered off (0x%02x)\n", reason);
    break;

  case BT_HCI_ERR_CONN_TIMEOUT:
    printk("disconnected: connection timeout (0x%02x)\n", reason);
    break;

  case BT_HCI_ERR_CONN_LIMIT_EXCEEDED:
    printk("disconnected: connection limit exceeded (0x%02x)\n", reason);
    break;

  case BT_HCI_ERR_UNACCEPT_CONN_PARAM:
    printk("disconnected: unacceptable connection parameters (0x%02x)\n",
           reason);
    break;

  case BT_HCI_ERR_UNSUPP_REMOTE_FEATURE:
    printk("disconnected: unsupported remote feature (0x%02x)\n", reason);
    break;

  case BT_HCI_ERR_PAIRING_NOT_SUPPORTED:
    printk("disconnected: pairing not supported (0x%02x)\n", reason);
    break;

  case BT_HCI_ERR_UNSPECIFIED:
    printk("disconnected: unspecified HCI error (0x%02x)\n", reason);
    break;

  default:
    printk("disconnected: reason 0x%02x\n", reason);
    break;
  }

  k_event_set(&bluetooth_event, DISCONNECTED);
}
```

## src/external_readings.c
```c
#include "external_readings.h"

#define SW0_NODE DT_ALIAS(sw0)
const struct gpio_dt_spec button = GPIO_DT_SPEC_GET_OR(SW0_NODE, gpios, {0});
static struct gpio_callback button_press_callback;

K_THREAD_STACK_DEFINE(gpio_sampling_thread_stack, 8192);
static struct k_thread gpio_sampling_thread;
static k_tid_t gpio_sampling_thread_id;

static bool gpio_initialized = false;

void button_pressed(const struct device *port, struct gpio_callback *cb,
                    gpio_port_pins_t pins) {
  store_reading(1);
}

int initialize_gpio_readings() {
  if (gpio_initialized) {
    return -1;
  }

  if (!gpio_is_ready_dt(&button)) {
    return -1;
  }

  int err = gpio_pin_configure_dt(&button, GPIO_INPUT);
  if (err != 0) {
    return err;
  }

  err = gpio_pin_interrupt_configure_dt(&button, GPIO_INT_EDGE_TO_ACTIVE);
  if (err != 0) {
    return err;
  }

  gpio_init_callback(&button_press_callback, button_pressed, BIT(button.pin));
  gpio_add_callback(button.port, &button_press_callback);

  gpio_initialized = true;

  return 0;
}

void sample_gpio_and_store(void *p1, void *p2, void *p3) {
  while (true) {
    k_sleep(K_MSEC(250));

    store_reading(0);
  }
}

int initialize_gpio_sampling() {
  if (!gpio_initialized) {
    return -1;
  }

  gpio_sampling_thread_id = k_thread_create(
      &gpio_sampling_thread, gpio_sampling_thread_stack,
      K_THREAD_STACK_SIZEOF(gpio_sampling_thread_stack), sample_gpio_and_store,
      NULL, NULL, NULL, 12, 0, K_NO_WAIT);

  return 0;
}
```

## src/external_readings.h
```c
#ifndef NOTIFIER_GPIO_READINGS_H
#define NOTIFIER_GPIO_READINGS_H

#include "storage.h"
#include "zephyr/drivers/gpio.h"

extern const struct gpio_dt_spec button;

typedef struct external_reading {
  uint8_t value;
  struct external_reading *next;
} external_reading_t;

int initialize_gpio_readings();
int initialize_gpio_sampling();

#endif // NOTIFIER_GPIO_READINGS_H
```

## src/storage.c
```c
#include "storage.h"

K_HEAP_DEFINE(storage, REQUIRED_MEMORY);

static external_reading_t *head;
static external_reading_t *tail;

static struct k_mutex mutex;
static bool is_initialized = false;

void initialize_storage() {
  if (is_initialized) {
    return;
  }
  uint8_t current_reading_position = 0;
  external_reading_t *current_node =
      k_heap_alloc(&storage, sizeof(external_reading_t), K_FOREVER);
  current_node->value = 0;
  head = current_node;

  while (current_reading_position < MAXIMUM_STORED_READINGS) {
    external_reading_t *next_node =
        k_heap_alloc(&storage, sizeof(external_reading_t), K_FOREVER);
    next_node->value = 0;
    current_node->next = next_node;
    current_node = current_node->next;
    current_reading_position = current_reading_position + 1;
  }

  tail = current_node;

  printk("initializing mutex for storage\n");
  k_mutex_init(&mutex);
  is_initialized = true;
}

void store_reading(const uint8_t value) {
  if (k_mutex_lock(&mutex, K_MSEC(100)) != 0) {
    printk("Failed to lock mutex, aborting storage\n");
    return;
  }

  external_reading_t *previous_head = head;
  head = head->next;
  k_heap_free(&storage, previous_head);

  external_reading_t *new_reading =
      k_heap_alloc(&storage, sizeof(external_reading_t), K_FOREVER);
  new_reading->value = value;

  tail->next = new_reading;
  tail = new_reading;

  k_mutex_unlock(&mutex);
}

uint8_t sum_stored_readings() {
  if (!is_initialized) {
    printk("Storage not initialized, aborting summation\n");
    return 0;
  }

  if (k_mutex_lock(&mutex, K_MSEC(100)) != 0) {
    printk("Failed to lock mutex, aborting summation\n");
    return 0;
  }

  uint8_t sum = 0;
  external_reading_t *current = head;
  while (current != tail) {
    sum += current->value;
    current = current->next;
  }

  k_mutex_unlock(&mutex);
  return sum;
}
```
