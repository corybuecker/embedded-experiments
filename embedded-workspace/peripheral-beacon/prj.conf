## CMakeLists.txt
```
cmake_minimum_required(VERSION 3.20.0)
find_package(Zephyr REQUIRED HINTS $ENV{ZEPHYR_BASE})
project(peripheral_beacon)
file(GLOB SOURCES "src/*.c")
target_sources(app PRIVATE ${SOURCES})
```

## prj.conf
```kconfig
# https://docs.zephyrproject.org/latest/kconfig.html
# Enables Zephyr's event subsystem for event-driven programming
CONFIG_EVENTS=y

# Enables GPIO (General Purpose Input/Output) driver support for controlling and reading digital pins
CONFIG_GPIO=y

# Sets the default Bluetooth device name, advertised and used in connections unless overridden at runtime
CONFIG_BT_DEVICE_NAME="Beacon 1"
# Enables Bluetooth 5.0 Extended Advertising for larger packets and advanced features
CONFIG_BT_EXT_ADV=y
# Allows the Bluetooth GATT database to be created/modified at runtime, not just at compile time
CONFIG_BT_GATT_DYNAMIC_DB=y
# Enables the Bluetooth Peripheral role, allowing the device to advertise and accept connections from Central devices
CONFIG_BT_PERIPHERAL=y
# Enables the full Bluetooth stack, including LE and (if available) Classic features
CONFIG_BT=y

# Enables the system console for input/output of system messages, shell, and debugging
CONFIG_CONSOLE=y
# Redirects printk() output to the Zephyr logging subsystem for unified log management
CONFIG_LOG_PRINTK=y
# Enables Zephyr’s structured, multi-level logging subsystem
CONFIG_LOG=y
# Enables the printk() function for simple, low-level debug output
CONFIG_PRINTK=y
# Routes system console output through SEGGER RTT for high-speed debug communication
CONFIG_RTT_CONSOLE=y
# Enables/disables routing the system console to a UART device (n = disables UART console)
CONFIG_UART_CONSOLE=n
# Enables/disables routing UART output over RTT (n = keeps UART and RTT output separate)
CONFIG_UART_RTT=n
# Enables use of SEGGER RTT for debug output and communication
CONFIG_USE_SEGGER_RTT=y

# Enables display of detailed thread information in debug output (names, priorities, stack usage)
CONFIG_DEBUG_THREAD_INFO=y
# Enables general debugging features, such as runtime checks and debug info
CONFIG_DEBUG=y
# Enables the tracing subsystem for recording and analyzing system events
CONFIG_TRACING=y
# Enables the Thread Monitor, which tracks thread states and can help detect deadlocks or long-running threads
CONFIG_THREAD_MONITOR=y
```

## src/main.c
```c
#include "connection.h"
#include "external_readings.h"
#include "storage.h"
#include "zephyr/bluetooth/bluetooth.h"
#include "zephyr/bluetooth/gatt.h"

static struct bt_conn_cb callbacks = {.connected = connected_callback,
                                      .disconnected = disconnected_callback};

#define SERVICE_UUID 0x183B

static uint8_t periodic_advertising_service_data[] = {
    BT_UUID_16_ENCODE(SERVICE_UUID),
    0,
};

static struct bt_data advertising_data[] = {
    BT_DATA(BT_DATA_NAME_COMPLETE, CONFIG_BT_DEVICE_NAME,
            sizeof(CONFIG_BT_DEVICE_NAME) - 1),
    BT_DATA(BT_DATA_SVC_DATA16, periodic_advertising_service_data,
            ARRAY_SIZE(periodic_advertising_service_data)),
};

static const struct bt_le_adv_param advertising_parameters[] =
    BT_LE_ADV_PARAM(BT_LE_ADV_OPT_EXT_ADV, BT_GAP_ADV_FAST_INT_MIN_2,
                    BT_GAP_ADV_FAST_INT_MAX_2, NULL);

static int start_advertising(struct bt_le_ext_adv *adv) {
  int err = bt_le_ext_adv_start(adv, BT_LE_EXT_ADV_START_DEFAULT);
  if (err) {
    printk("Failed to start main advertising (err %d)\n", err);
    return err;
  }

  if (!err) {
    k_event_set(&bluetooth_event, ADVERTISING);
  }

  return err;
}

int main(void) {
  int err;

  // This must remain valid memory for the duration of the program. Make it more
  // challenging to move into a function.
  struct bt_le_ext_adv *advertisement_set;

  err = bt_enable(NULL);
  if (err) {
    return err;
  }

  err = bt_le_ext_adv_create(advertising_parameters, NULL, &advertisement_set);
  if (err) {
    return err;
  }

  err = bt_le_ext_adv_set_data(advertisement_set, advertising_data,
                               ARRAY_SIZE(advertising_data), NULL, 0);
  if (err) {
    printk("Failed to set advertising data (err %d)\n", err);
    return err;
  }

  err = bt_conn_cb_register(&callbacks);
  if (err) {
    return err;
  }

  err = start_advertising(advertisement_set);
  if (err) {
    printk("Failed to start advertising (err %d)\n", err);
    return err;
  }

  printk("Initializing memory for %d readings\n", 25);
  initialize_storage();

  err = initialize_gpio_readings();
  if (err) {
    printk("could not initialize GPIO readings (err %d)\n", err);
    return err;
  }

  err = initialize_gpio_sampling();
  if (err) {
    printk("could not initialize GPIO sampling (err %d)\n", err);
    return err;
  }

  while (true) {
    k_sleep(K_MSEC(125));

    // Update periodic advertising data with the latest reading
    const uint8_t reading = sum_stored_readings();

    periodic_advertising_service_data[2] = reading;

    err = bt_le_ext_adv_set_data(advertisement_set, advertising_data,
                                 ARRAY_SIZE(advertising_data), NULL, 0);

    if (err) {
      printk("could not set advertising data (err %d)\n", err);
      return err;
    }
  }
}
```

## src/connection.c
```c
#include "connection.h"

K_EVENT_DEFINE(bluetooth_event);
struct bt_conn *default_connection;

void connected_callback(struct bt_conn *connection, uint8_t err) {
  if (err) {
    return;
  }

  if (default_connection == NULL) {
    default_connection = bt_conn_ref(connection);
  }

  if (default_connection != connection) {
    return;
  }

  printk("client connected to server...");

  k_event_set(&bluetooth_event, CONNECTED);
}

void disconnected_callback(struct bt_conn *connection, uint8_t reason) {
  bt_conn_unref(default_connection);
  default_connection = NULL;

  switch (reason) {
    case BT_HCI_ERR_AUTH_FAIL:
      printk("disconnected: authentication failed (0x%02x)\n", reason);
      break;

    case BT_HCI_ERR_REMOTE_USER_TERM_CONN:
      printk("disconnected: remote user terminated connection (0x%02x)\n",
             reason);
      break;

    case BT_HCI_ERR_REMOTE_LOW_RESOURCES:
      printk("disconnected: remote low resources (0x%02x)\n", reason);
      break;

    case BT_HCI_ERR_REMOTE_POWER_OFF:
      printk("disconnected: remote powered off (0x%02x)\n", reason);
      break;

    case BT_HCI_ERR_CONN_TIMEOUT:
      printk("disconnected: connection timeout (0x%02x)\n", reason);
      break;

    case BT_HCI_ERR_CONN_LIMIT_EXCEEDED:
      printk("disconnected: connection limit exceeded (0x%02x)\n", reason);
      break;

    case BT_HCI_ERR_UNACCEPT_CONN_PARAM:
      printk("disconnected: unacceptable connection parameters (0x%02x)\n",
             reason);
      break;

    case BT_HCI_ERR_UNSUPP_REMOTE_FEATURE:
      printk("disconnected: unsupported remote feature (0x%02x)\n", reason);
      break;

    case BT_HCI_ERR_PAIRING_NOT_SUPPORTED:
      printk("disconnected: pairing not supported (0x%02x)\n", reason);
      break;

    case BT_HCI_ERR_UNSPECIFIED:
      printk("disconnected: unspecified HCI error (0x%02x)\n", reason);
      break;

    default:
      printk("disconnected: reason 0x%02x\n", reason);
      break;
  }

  k_event_set(&bluetooth_event, DISCONNECTED);
}
```
